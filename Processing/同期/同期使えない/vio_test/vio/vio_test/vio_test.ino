#include <Wire.h>
#include <avr/pgmspace.h>

#define SLAVE_ADDRESS 0x09  // ヴァイオリンのアドレス

const uint8_t CMD_START = 0x01;
const uint8_t CMD_PLAY  = 0x02;
const uint8_t CMD_STOP  = 0x03;
const uint8_t CMD_BPM   = 0x04;

volatile boolean playTriggered = false;
volatile boolean stopTriggered = false;
volatile float tempoScale = 1.0;    // ★修正: 割り込みで変更されるため volatile を追加

boolean isPlaying = false;          
unsigned long lastSendTime = 0;     
const float BASE_LOOP_DURATION = 24.2; // 最後の音23.0秒 + 伴奏の長さ1.2秒 = 24.2秒

// ★楽譜データ（変更なし）
const float startTimes[] PROGMEM = {
  0.00, 0.00, 0.00, 0.00, 0.50, 1.00, 1.00, 1.00, 1.00, 1.50,
  2.00, 2.00, 2.00, 2.00, 2.50, 3.00, 3.00, 3.00, 3.00, 4.00,
  4.00, 4.00, 4.00, 4.50, 5.00, 5.00, 5.00, 5.00, 5.50, 6.00,
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  22.00, 22.00, 22.00, 22.00, 22.50, 23.00, 23.00, 23.00, 23.00
};
const float durations[] PROGMEM = {
  0.80, 0.80, 0.80, 0.30, 0.30, 0.80, 0.80, 0.80, 0.30, 0.30,
  0.80, 0.80, 0.80, 0.30, 0.30, 0.80, 0.80, 0.80, 0.80, 0.80,
  0.80, 0.80, 0.30, 0.30, 0.80, 0.80, 0.80, 0.30, 0.30, 0.80,
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  0.80, 0.80, 0.80, 0.30, 0.30, 1.20, 1.20, 1.20, 0.80
};
const float baseFreqs[] PROGMEM = {
  261.63, 329.63, 392.00, 523.25, 523.25, 329.63, 392.00, 493.88, 783.99, 783.99,
  349.23, 440.00, 523.25, 880.00, 880.00, 261.63, 329.63, 392.00, 783.99, 349.23,
  440.00, 523.25, 698.46, 698.46, 261.63, 329.63, 392.00, 659.26, 659.26, 196.00,
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  196.00, 246.94, 293.66, 587.33, 587.33, 261.63, 329.63, 392.00, 523.25
};
const float amplitudes[] PROGMEM = {
  0.12, 0.12, 0.12, 0.30, 0.30, 0.12, 0.12, 0.12, 0.30, 0.30,
  0.12, 0.12, 0.12, 0.30, 0.30, 0.12, 0.12, 0.12, 0.35, 0.12,
  0.12, 0.12, 0.30, 0.30, 0.12, 0.12, 0.12, 0.30, 0.30, 0.12,
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  0.12, 0.12, 0.12, 0.30, 0.30, 0.15, 0.15, 0.15, 0.35
};

int numNotes = 119;

void setup() {
  Serial.begin(115200);
  Wire.begin(SLAVE_ADDRESS);
  Wire.onReceive(receiveEvent);
}

void loop() {
  if (playTriggered) {
    playTriggered = false;
    isPlaying = true;
    sendSongData();
    lastSendTime = millis();
  }

  if (isPlaying) {
    unsigned long currentLoopDuration = BASE_LOOP_DURATION * tempoScale * 1000;
    if (millis() - lastSendTime >= currentLoopDuration) {
      sendSongData();          
      lastSendTime = millis(); 
    }
  }

  if (stopTriggered) {
    isPlaying = false;      
    Serial.println("stop"); 
    stopTriggered = false;
  }
}

void sendSongData() {
  for (int i = 0; i < numNotes; i++) {
    float startTime = pgm_read_float(&startTimes[i]);
    float duration  = pgm_read_float(&durations[i]);
    float freq      = pgm_read_float(&baseFreqs[i]);
    float amp       = pgm_read_float(&amplitudes[i]);

    float playTime = (startTime * tempoScale) + 0.5; 
    float playDuration = duration * tempoScale;
    int instType = 3; 

    Serial.print(instType);       Serial.print(",");
    Serial.print(playTime, 2);    Serial.print(",");
    Serial.print(freq, 2);        Serial.print(",");
    Serial.print(playDuration, 2);Serial.print(",");
    Serial.println(amp, 2);

    delay(2); 
  }
}

void receiveEvent(int howMany) {
  if (Wire.available() > 0) {
    uint8_t cmd = Wire.read();

    if (cmd == CMD_PLAY) {
      playTriggered = true;
    }
    else if (cmd == CMD_STOP) {
      playTriggered = false;
      stopTriggered = true; 
    }
    else if (cmd == CMD_BPM) {
      if (Wire.available() > 0) {
        uint8_t bpm = Wire.read();
        tempoScale = 120.0 / bpm;
      }
    }
  }
}